## meta-ref-os-iot/conf/distro/ref-os-iot.conf
```bitbake
require conf/distro/ref_os_includes.inc
require conf/distro/distro-include/security_flags.inc

DISTRO = "ref-os-iot"
DISTRO_NAME = "Ref-Os-Iot"
# The version is bumped after each official release.
# This implies that new releases go out with a version
# string based on the predecessor plus the suffix, which
# was deemed sufficient in the "[Reference OS for IOT-dev] versioning Reference OS for IOT"
# mail thread.
DISTRO_VERSION = "1.0+snapshot-${DATE}"
DISTRO_VERSION[vardepsexclude] = "DATE"
SDK_VENDOR = "-refossdk"
SDK_VERSION := "${@'${DISTRO_VERSION}'.replace('snapshot-${DATE}','snapshot')}"
SDK_NAME_PREFIX = "refos"

# SDK_UPDATE_URL defines the eSDK updateserver configured in
# devtool.conf when populate-sdk-ext is run.
#
# The default setting can be overridded in local.conf
REF_OS_SDK_UPDATE_URL ??= "${REFKIT_SDK_UPDATE_URL}"
SDK_UPDATE_URL = "${REF_OS_SDK_UPDATE_URL}"

#
# Package Management configuration
#
# This variable lists which packaging formats to enable. Multiple package backends
# can be enabled at once and the first item listed in the variable will be used
# to generate the root filesystems.
# Options are:
#  - 'package_deb' for debian style deb files
#  - 'package_ipk' for ipk files are used by opkg (a debian style embedded package manager)
#  - 'package_rpm' for rpm style packages
# E.g.: PACKAGE_CLASSES ?= "package_rpm package_deb package_ipk"
# We default to ipk because it is faster/smaller and good enough for
# image creation. On-device package management is disabled by default
# and thus the additional features offered for that by rpm/deb do not
# matter.
PACKAGE_CLASSES ?= "package_deb"

# Extensible SDK configuration: Reference OS for IOT uses "minimal" type which minimizes the size of the downloaded
# SDK itself and configures devtool to use SSTATE_MIRROR (defined in sdk-extra.conf).
# The package data available gets recorded. This has the side-effect that exporting the eSDK
# for a certain image will not only cover the image, but also all packages that are included
# in a world build, and for doing that it will build all these packages.
#SDK_EXT_TYPE = "minimal"
#SDK_INCLUDE_PKGDATA = "1"

# Set custom tasks from Reference OS for IOT layers as recursive dependencies to do_populate_sdk.
#SDK_RECRDEP_TASKS = "do_deploy_files do_uefiapp"

# Blacklist inherited classes that break proper data restore from SSTATE when populating the SDK.
#SDK_INHERIT_BLACKLIST = "buildhistory icecc buildhistory-extra buildstats-summary archiver isafw test-iot"

# The variable BB_NUMBER_PARSE_THREADS set in CI in order to
# limit the number of parse threads should not leak to the user's
# environment since it may increase SDK installation time and
# worsen runtime performance on capable systems.
#SDK_LOCAL_CONF_BLACKLIST_append = " BB_NUMBER_PARSE_THREADS"

# Disable SSTATE locked sigs checks. SDK_INHERIT_BLACKLISTed classes
# used in CI (and mirrored SSTATE) cause locked signature file check
# failures with eSDK installation. Until the blacklisted classes are
# fixed, SSTATE checks need to be run in self-tests.
#SIGGEN_LOCKEDSIGS_TASKSIG_CHECK = "none"

INHERIT += ""

# Reference OS for IOT tries to build minimal images and thus prefers Busybox or
# Toybox over coreutils or any other package providing similar
# functionality. For technical reasons, this is crucial when building
# swupd bundles: Busybox/Toybox must be picked consistently, even when
# a bundle pulls in alternatives like coreutils which normally would
# have a higher priority.
#
# This gets achieved in two ways:
# 1. via refkit-update-alternatives.bbclass we modify all packages
#    so that their update-alternatives priority can be modified
#    during install time
# 2. in refkit-image.bbclass we reconfigure those priorities
#    as necessary
#
# This is still a change that is done consistently for all images,
# whether they use swupd or not, to ensure that the result is
# identical. Doing it at image creation time reduces the need
# for recompilations of packages and opens up the possibility
# for downstream developers to override the defaults while
# reusing pre-compiled binaries from our sstate.
INHERIT += ""

MAINTAINER = "Project Name <noname@example.com>"

TARGET_VENDOR = "-refos"
REF_OS_DEFAULT_EXTRA_RDEPENDS = "${REFKIT_DEFAULT_EXTRA_RDEPENDS}"
REF_OS_DEFAULT_EXTRA_RRECOMMENDS = "${REFKIT_DEFAULT_EXTRA_RRECOMMENDS}"

# Smack security is a distribution feature which can be enabled or
# disabled as needed. To simplify recipes, there is also a smack
# override.
#
# At the moment, these settings must be kept in sync manually: the
# "smack" override must be set if and only if the "smack" distro
# feature is set.
#
# In other words, to disable the default in a local.conf, change two variables
# like this:
#  REFKIT_SMACK_OVERRIDE = ""
#  REFKIT_DEFAULT_DISTRO_FEATURES_remove = "smack"

#REFKIT_DEFAULT_DISTRO_FEATURES += "smack"
#REFKIT_SMACK_OVERRIDE ?= ":smack"
#DISTROOVERRIDES .= "${REFKIT_SMACK_OVERRIDE}"

# IMA/EVM depend on compiling some components (currently the kernel)
# differently. This distro feature enables that.
#REFKIT_DEFAULT_DISTRO_FEATURES += "ima"

# ptests are useful for QA. Enabling them in the distro creates
# additional packages in each recipe that supports ptests and thus
# allows building images with those tests included. Enabling ptests
# should have no effect on normal packages; if there is an effect,
# then that is a bug in the recipe.
REF_OS_DEFAULT_DISTRO_FEATURES = "x11 wifi bluetooth opengl pulseaudio"

# enable Java as distro feature - this adds the java-jdk package group into
# images and enables Java bindings and other Java dependent features
#REFKIT_DEFAULT_DISTRO_FEATURES += "java"

# Remove currently unsupported distro features from global defaults
DISTRO_FEATURES_DEFAULT_remove = ""

DISTRO_FEATURES += "${REF_OS_DEFAULT_DISTRO_FEATURES}"

# set required kernel subtype options
PREFERRED_PROVIDER_virtual/kernel_intel-corei7-64 ?= "linux-yocto"
PREFERRED_VERSION_linux-yocto_intel-corei7-64 ?= "4.4%"
LINUXLIBCVERSION ?= "4.4%"

# Use pseudo 1.7.x because of the performance regression
# (https://bugzilla.yoctoproject.org/show_bug.cgi?id=9929)
# in pseudo 1.8.1.
#PREFERRED_VERSION_pseudo ?= "1.7.%"

# Use UEFI-based "dsk" image format for machines supporting UEFI.
# Defined here because it influences several different recipes.
#REFKIT_USE_DSK_IMAGES ?= "${@bb.utils.contains_any('MACHINE', 'intel-core2-32 intel-corei7-64 intel-quark', 'True', 'False', d)}"

DISTRO_EXTRA_RDEPENDS += " ${REF_OS_DEFAULT_EXTRA_RDEPENDS}"
DISTRO_EXTRA_RRECOMMENDS += " ${REF_OS_DEFAULT_EXTRA_RRECOMMENDS}"

QEMU_TARGETS += ""

# Set PREMIRRORS to prioritize Reference OS for IOT autobuilder source cache.
# The REFOS_SOURCE_MIRROR_URL can be overriden in local.conf.
REFOS_SOURCE_MIRROR_URL ??= "https://download.01.org/ref-os-iot/mirror/source/"
SOURCE_MIRROR_URL = "${REFOS_SOURCE_MIRROR_URL}"
INHERIT += "own-mirrors"

VIRTUAL-RUNTIME_init_manager += ""
VIRTUAL-RUNTIME_initscripts += ""
DISTRO_FEATURES_BACKFILL_CONSIDERED += ""

# Build distro stateless, i.e. with /etc empty straight out of the box
# and reserved for customizations by the admin.
#require conf/distro/include/stateless.inc

# QA check settings - a little stricter than the OE-Core defaults
#WARN_TO_ERROR_QA = "already-stripped compile-host-path install-host-path \
#                    installed-vs-shipped ldflags pn-overrides rpaths staticdev \
#                    useless-rpaths build-deps"
#WARN_QA_remove = "${WARN_TO_ERROR_QA}"
#ERROR_QA_append = " ${WARN_TO_ERROR_QA}"

# Add some Reference OS for IOT specific checks in addition to those provided by sanity.bbclass.
#INHERIT += "refkit-sanity"

#INHERIT += "blacklist"
#PNBLACKLIST[refkit-image-swupd] = "swupd not available"

# The swupd update mechanism currently does not cope with user or
# group IDs that change between builds
# (https://github.com/clearlinux/swupd-client/issues/101). Even if it
# did, changing IDs would make the update more complicated (larger
# delta, daemons need to be restarted, etc.), so it is better to
# ensure that IDs are static.
#
# Reference OS for IOT uses the static uid and gid mechanism from OE-core for that
# (http://www.yoctoproject.org/docs/latest/mega-manual/mega-manual.html#ref-classes-useradd),
# with custom support for adding systemd sysusers in Reference OS for IOT's
# systemd-sysusers.bbclass.  The OE-core mechanism for that currently
# lacks support for static IDs and thus cannot be used yet
# (https://bugzilla.yoctoproject.org/show_bug.cgi?id=9789).
#
# Dynamically assigned IDs are detected and lead to an error during
# the build. For example, the dbus recipe creates a "messagebus"
# group. Not defining that group causes an error when parsing the
# recipe and makes it unusable, leading to the following errors
# during "bitbake dbus":
# ERROR: Nothing PROVIDES 'dbus'
# ERROR: dbus was skipped: Function failed: dbus - dbus: username messagebus does not have a static ID defined.
#
# When building images, the errors shows up as missing components
# which are required for the build, as in "bitbake refkit-image-noswupd":
# ERROR: Nothing RPROVIDES 'udev' (but /work/iot-ref-kit/meta/recipes-core/packagegroups/packagegroup-core-boot.bb, /work/iot-ref-kit/meta/recipes-core/initrdscripts/initramfs-framework_1.0.bb RDEPENDS on or otherwise requires it)
# ERROR: Required build target 'refkit-image-noswupd' has no buildable providers.
#
# The advantage of this mechanism is the decentralized assignment of
# IDs without modifying the OS or recipes.
#
# Developers who need to add new entries should add their own mapping
# file to USERADD_UID_TABLES and/or USERADD_GID_TABLES, either in a
# derived distro config or in their local.conf. Reference OS for IOT reserves
# the value range < 2000.
#
# For experiments and builds not involving swupd it is also possible to
# disable the mechanism by modifying USERADD_ERROR_DYNAMIC:
# "warn" merely prints a warning, empty value silently allows dynamic
# ID allocation.
USERADDEXTENSION += "useradd-staticids"
USERADD_ERROR_DYNAMIC += ""
USERADD_UID_TABLES += "conf/distro/include/refos-passwd"
USERADD_GID_TABLES += "conf/distro/include/refos-group"

# Only specific recipes are supported by the Reference OS for IOT Project. Those
# recipes are listed in the following file.
#
# It is possible to add additional file names, for example in derived
# distros or products, separated by spaces, or completely replace the
# default list.
SUPPORTED_RECIPES += "${META_REF_OS_BASE}/conf/distro/distro-include/ref-os-supported-recipes.txt"

#SUPPORTED_RECIPES[devtool-supported-recipes.txt] = "developer"
#SUPPORTED_RECIPES[refkit-supported-recipes.txt] = "refkit"

# Inheriting this class ensures that a "world build" of Reference OS for IOT only
# builds the supported recipes. In addition, local.conf.sample activates
# a check that ensures that nothing gets built which is not supported.
INHERIT += ""

# In some (rare) cases there are name clashes between layers and we would end up
# using an undesired version of a recipe. The supported-recipes.bbclass detects
# when a recipe comes from a different layer than expected. When that happens,
# we have to ignore the undesired one. Could be done with blacklisting, but
# BBMASKing it is easier. If a derived distro does not agree with the Reference OS for IOT
# choice, they can unset REFKIT_BBMASK.
REF_OS_BBMASK = "/meta-oe/recipes-graphics/xserver-nodm-init/"
BBMASK += "${REF_OS_BBMASK}"

# However, not all supported recipes also need to be part of a world
# build. It is enough that they can be built if needed for a specific
# image. Those recipes we remove from world explicitly.
#EXCLUDE_FROM_WORLD_pn-u-boot = "1"
#EXCLUDE_FROM_WORLD_pn-u-boot-edison = "1"
#EXCLUDE_FROM_WORLD_pn-u-boot-fw-utils-edison = "1"
#EXCLUDE_FROM_WORLD_pn-initramfs-boot = "1"

# Nothing prevents building something (like a custom image, for
# example) also with other recipes included in a build. However,
# sometimes that is unintentional or even an error, for example when
# some unexpected component gets pulled in via an unanticipated
# dependency change.
#
# To enable a warning about this before the build starts, set this
# variable to "warn" in local.conf. "fatal" prints the same message
# and aborts the build automatically.
#
# SUPPORTED_RECIPES_CHECK = "warn"

# Java bootstrapping
#PREFERRED_PROVIDER_virtual/java-initial-native = "cacao-initial-native"
#PREFERRED_PROVIDER_virtual/java-native = "cacao-native"
#PREFERRED_PROVIDER_virtual/javac-native = "ecj-bootstrap-native"

# Java runtime: used by packagegroup-java-jdk.bb and packages which
# RDEPEND on Java.
#
# Must use openjdk-8 because Reference OS for IOT is meant to support on-device
# compilation of Java programs, and we don't want to end up
# compiling and installing both jre and jdk (they are separate
# packages which share no files).
#PREFERRED_RPROVIDER_java2-runtime = "openjdk-8"

# Setting GCCVERSION allows downgrading the compiler to 5.x
# GCCVERSION ?= "5.%"

# Compiling openjdk-8 has some support for compiling with gcc 6.x, but that
# support passes -fno-lifetime-dse also to the host compiler, causing
# openjdk-8-native do_configure to fail ("cannot produce executables") and
# in openjdk-8 do_compile to fail on some helper tools. Problem reported
# upstream, see http://thread.gmane.org/gmane.comp.handhelds.openembedded/75469
# In the meantime we just remove the offending (and unneeded, while we
# are on gcc 5.x) flag:
#CFLAGS_remove_pn-openjdk-8-native = "-fno-lifetime-dse"
#CFLAGS_remove_pn-openjdk-8 = "-fno-lifetime-dse"
#CFLAGS_remove_pn-openjre-8-native = "-fno-lifetime-dse"
#CFLAGS_remove_pn-openjre-8 = "-fno-lifetime-dse"
#CXXFLAGS_remove_pn-openjdk-8-native = "-fno-lifetime-dse"
#CXXFLAGS_remove_pn-openjdk-8 = "-fno-lifetime-dse"
#CXXFLAGS_remove_pn-openjre-8-native = "-fno-lifetime-dse"
#CXXFLAGS_remove_pn-openjre-8 = "-fno-lifetime-dse"

# Reference OS for IOT removes certain packages from images because the components are known
# to have compile issues and/or are not supported. Can be modified in derived
# distros or via local.conf.
REF_OS_REMOVE_PACKAGES ?= ""
RDEPENDS_packagegroup-core-device-devel_remove_pn-packagegroup-core-device-devel += "${REF_OS_REMOVE_PACKAGES}"
RDEPENDS_packagegroup-core-tools-profile_remove_pn-packagegroup-core-tools-profile += "${REF_OS_REMOVE_PACKAGES}"

# It is uncertain whether rhino is really an allarch package. It's signature
# is different among machines, causing the iotsstatetests.SStateTests.test_sstate_samesigs
# to fail. We play it save here and make the recipe specific to the tune flags.
# Needs further investigations by upstream.
#PACKAGE_ARCH_pn-rhino = "${TUNE_PKGARCH}"

# Set a proper filter to classify internal vs. external patches (only internal
# patches are of interest) in the patch summary created by inputanalyzer.
#INPUTANALYZER_WHITELIST = '/(meta|meta-yocto-bsp|meta-intel|meta-java|meta-oic|meta-oe|meta-networking|meta-python|meta-intel-iot-middleware|meta-security-isafw)/*$ ^$'

# re-use uninative shim released by Yocto Project / OE
#require conf/distro/include/yocto-uninative.inc
#INHERIT += "uninative"

# Disable running fsck at boot. System clock is typically wrong at early boot
# stage due to lack of RTC backup battery. This causes unnecessary fixes being
# made due to filesystem metadata time stamps being in future.
#APPEND_append = " fsck.mode=skip"

PREFERRED_PROVIDER_virtual/opencl-headers ?= "beignet"
PREFERRED_PROVIDER_virtual/opencl-headers-cxx ?= "beignet"

# Some recipes (like fwts) started to use compile
# flags that only work with gcc 6. Need to
# remove them.
CFLAGS_remove = "-Wno-error=misleading-indentation"
CXXFLAGS_remove = "-Wno-error=misleading-indentation"

# Set kernel panic timeout to 5 seconds
APPEND_append = " panic=5"

# Remove this when we move to the latest refkit as this is available there.
# for now without this wic image creation fails with deb packages
do_image_wic[depends] += "e2fsprogs-native:do_populate_sysroot"
```
