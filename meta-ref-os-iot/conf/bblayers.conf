## meta-ref-os-iot/conf/distro/ref_os_includes.inc
```bitbake
require conf/distro/refkit.conf

# Distro specific package configurations
require conf/distro/distro-include/x11-config.inc

# Distro modified package dependencies
require conf/distro/distro-include/ref-os-added-dependencies.inc
require conf/distro/distro-include/ref-os-removed-dependencies.inc
```

## meta-ref-os-iot/conf/layer.conf
```bitbake
# We have a conf and classes directory, add to BBPATH. Add it at the
# front because we want to override files like fs-perms.txt.
BBPATH =. "${LAYERDIR}:"

# We have recipes-* directories, add to BBFILES
BBFILES += "${LAYERDIR}/recipes-*/*/*.bb \
	${LAYERDIR}/recipes-*/*/*.bbappend \
        ${LAYERDIR}/fixes/*/recipes-*/*/*.bb \
        ${LAYERDIR}/fixes/*/recipes-*/*/*.bbappend \
        ${LAYERDIR}/fixes/*/recipes-*/*/*/*.bb \
        ${LAYERDIR}/fixes/*/recipes-*/*/*/*.bbappend \
"

# Set a variable to get to the top of the metadata location
IMAGE_DSK_BASE := '${LAYERDIR}'

# Set a variable to get to the top of the Reference OS for IOT metadata location.
META_REF_OS_BASE := '${LAYERDIR}'

# Used by image-dsk.bbclass to find lib/image-dsk.py.
IMAGE_DSK_BASE ?= '${META_REF_OS_BASE}'

# Required by stateless.bbclass to find patches needed only when
# compiling stateless.
STATELESS_PATCHES_BASE ?= "${META_REF_OS_BASE}/conf/distro/stateless-patches"

BBFILE_COLLECTIONS += "ref-os-iot"
BBFILE_PATTERN_ref-os-iot := "^${LAYERDIR}/"
BBFILE_PRIORITY_ref-os-iot = "7"

# This and the corresponding CONF_VERSION value in local.conf.sample
# need to be increased by one each time a change is made to
# local.conf.sample that requires manually updating a local.conf after
# updating the meta data.
#
# A separate, Reference OS for IOT specific variable is used to make the value
# available to derived distros.
REFKIT_LOCALCONF_VERSION = "2"
LOCALCONF_VERSION = "${REFKIT_LOCALCONF_VERSION}"

# Same for LCONF_VERSION in bblayer.conf.sample.
REFKIT_LAYER_CONF_VERSION = "2"
LAYER_CONF_VERSION = "${REFKIT_LAYER_CONF_VERSION}"

# The default error messages use shell meta* wildcards to find the
# conf files which in refkit happen to match two files (one from
# meta and the real one from meta-refkit). Be more specific to avoid
# user confusion.
SANITY_LOCALCONF_SAMPLE = "${META_REF_OS_BASE}/conf/local.conf.sample"
SANITY_BBLAYERCONF_SAMPLE = "${META_REF_OS_BASE}/conf/bblayers.conf.sample"
```

## meta-ref-os-iot/meta-5xx/conf/bblayers.conf.sample
```bitbake
# LAYER_CONF_VERSION is increased each time build/conf/bblayers.conf
# changes incompatibly
LCONF_VERSION = "1"

BBPATH = "${TOPDIR}"
BBFILES ?= ""

# REF-OS layers
require ${TOPDIR}/../meta-ref-os-iot/conf/bblayers.conf

# Extra layers
REF_OS_EXTRA_LAYERS ?= "\
 ${TOPDIR}/../meta-ref-os-iot/meta-5xx \
"

BBLAYERS += "${REF_OS_EXTRA_LAYERS}"
BBLAYERS_NON_REMOVABLE += "${REF_OS_EXTRA_LAYERS}"
```

## meta-ref-os-iot/meta-5xx/conf/layer.conf
```bitbake
# We have a conf and classes directory, add to BBPATH. Add it at the
# front because we want to override files like fs-perms.txt.
BBPATH =. "${LAYERDIR}:"

# We have recipes-* directories, add to BBFILES
BBFILES += "${LAYERDIR}/recipes-*/*/*.bb \
	${LAYERDIR}/recipes-*/*/*.bbappend \
        ${LAYERDIR}/fixes/*/recipes-*/*/*.bb \
        ${LAYERDIR}/fixes/*/recipes-*/*/*.bbappend \
        ${LAYERDIR}/fixes/*/recipes-*/*/*/*.bb \
        ${LAYERDIR}/fixes/*/recipes-*/*/*/*.bbappend \
"

BBFILE_COLLECTIONS += "5xx"
BBFILE_PATTERN_5xx := "^${LAYERDIR}/"
BBFILE_PRIORITY_5xx = "8"
```

## meta-ref-os-iot/meta-5xx/conf/machine/intel-5xx-64.conf
```bitbake
require conf/machine/intel-corei7-64.conf

MACHINEOVERRIDES =. "intel-corei7-64:"
INTEL_MACHINE_SUBTYPE = "broxton-m"

REFKIT_USE_DSK_IMAGES = "True"

APPEND_append = " console=ttyS2,115200 video=efifb maxcpus=4 reboot=efi kmemleak=off net.ifnames=0 i915.disable_hpd_poll=true"
SERIAL_CONSOLES = "115200;ttyS2"

MACHINE_EXTRA_RDEPENDS = "\
    thermald \
    backport-iwlwifi \
    5xx-comms-leds \
    resize-rootfs \
"

MACHINE_EXTRA_RRECOMMENDS = "\
    5xx-udev-rules \
    i2s-audio \
"
KERNEL_MODULE_AUTOLOAD  += "5xx_comms_leds"

#IMAGE_CLASSES += "image_types_fastboot_5xx"
#IMAGE_FSTYPES += "fastboot_5xx"
```

## meta-ref-os-iot/meta-edison/conf/machine/edison.conf
```bitbake
#@TYPE: Machine
#@NAME: edison
#@DESCRIPTION: Machine configuration for edison systems

include conf/machine/include/tune-atom.inc

MACHINE_FEATURES = "bluetooth alsa pci serial usbgadget usbhost wifi x86 ext3 systemd"

IMAGE_CLASSES = "image_types_edison"
IMAGE_FSTYPES = " tar.bz2 ext4 toflash"
REFKIT_USE_DSK_IMAGES = "0"
IMAGE_ROOTFS_SIZE = "524288"

# Bootloader config

PREFERRED_PROVIDER_virtual/bootloader ?=  "u-boot"
PREFERRED_VERSION_u-boot ?= "2015.10"
PREFERRED_VERSION_u-boot-fw-utils ?= "2015.10"
UBOOT_MACHINE = "edison_config"

MACHINE_ESSENTIAL_EXTRA_RRECOMMENDS += "u-boot u-boot-fw-utils kernel-modules sst-fw mcu-fw-bin mcu-fw-load"

# Kernel config

PREFERRED_PROVIDER_virtual/kernel ?= "linux-yocto-edison"
PREFERRED_VERSION_linux-yocto-edison ?= "3.10.98"
KERNEL_IMAGETYPE = "bzImage"
SERIAL_CONSOLES ?= "115200;ttyMFD2"

KERNEL_MODULE_AUTOLOAD += "bcm_bt_lpm"
KERNEL_MODULE_AUTOLOAD += "bcm4334x"
module_conf_bcm4334x = "options bcm4334x firmware_path=/etc/firmware/fw_bcmdhd.bin nvram_path=/etc/firmware/bcmdhd.cal op_mode=4"

MACHINE_ESSENTIAL_EXTRA_RRECOMMENDS += "kernel-module-g-multi"
KERNEL_MODULE_AUTOLOAD  += "g_multi"
module_conf_g_multi = "options g_multi file=/dev/mmcblk0p8 ro=1 stall=0 idVendor=0x8087 idProduct=0x0A9E iProduct=Edison iManufacturer=Intel"

KERNEL_MODULE_PROBECONF += "bcm4334x g_multi"

XSERVER = "xserver-xorg \
           xf86-input-keyboard \
           xf86-input-evdev \
           xf86-video-dummy"

MACHINE_EXTRA_RDEPENDS = " \
    resize-rootfs \
    bcm43340-fw \
    bcm43340-bt \
    bcm43340-mod \
    bluetooth-rfkill-event \
"

MACHINE_EXTRA_RRECOMMENDS = " \
    ap-mode-toggle \
    battery-voltage \
    watchdog-sample \
    post-install \
    zeromq-dev \
    packagegroup-core-buildessential \
    cppzmq-dev \
"
# in Edison rfkill and connman together breaks bluetooth
# remove the dependency of connectivity package in edison
RDEPENDS_packagegroup-core-connectivity_remove = "connman"
RDEPENDS_packagegroup-tools-interactive_remove = "connman-client"
```
