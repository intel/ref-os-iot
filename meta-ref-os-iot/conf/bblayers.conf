## meta-ref-os-iot/conf/bblayers.conf
```bitbake
REFKIT_LAYERS = "\
  ${TOPDIR}/../intel-iot-refkit/openembedded-core/meta \
  ${TOPDIR}/../intel-iot-refkit/openembedded-core/meta-selftest \
  ${TOPDIR}/../intel-iot-refkit/meta-intel \
  ${TOPDIR}/../intel-iot-refkit/meta-refkit \
  ${TOPDIR}/../intel-iot-refkit/meta-refkit-core \
  ${TOPDIR}/../intel-iot-refkit/meta-refkit-gateway \
  ${TOPDIR}/../intel-iot-refkit/meta-refkit-computervision \
  ${TOPDIR}/../intel-iot-refkit/meta-oic \
  ${TOPDIR}/../intel-iot-refkit/meta-iot-web \
  ${TOPDIR}/../intel-iot-refkit/meta-iotqa \
  ${TOPDIR}/../intel-iot-refkit/meta-security \
  ${TOPDIR}/../intel-iot-refkit/meta-security-isafw \
  ${TOPDIR}/../intel-iot-refkit/meta-openembedded/meta-filesystems \
  ${TOPDIR}/../intel-iot-refkit/meta-openembedded/meta-gnome \
  ${TOPDIR}/../intel-iot-refkit/meta-openembedded/meta-filesystems \
  ${TOPDIR}/../intel-iot-refkit/meta-openembedded/meta-networking \
  ${TOPDIR}/../intel-iot-refkit/meta-openembedded/meta-oe \
  ${TOPDIR}/../intel-iot-refkit/meta-openembedded/meta-perl \
  ${TOPDIR}/../intel-iot-refkit/meta-openembedded/meta-python \
  ${TOPDIR}/../intel-iot-refkit/meta-openembedded/meta-xfce \
  ${TOPDIR}/../intel-iot-refkit/meta-intel-realsense \
  ${TOPDIR}/../intel-iot-refkit/meta-clang \
  "

BBLAYERS ?= "${REFKIT_LAYERS}"
BBLAYERS_NON_REMOVABLE ?= "${REFKIT_LAYERS}"

REF-OS_LAYERS = "\
  ${TOPDIR}/../meta-ref-os-iot \
  ${TOPDIR}/../meta-ref-os-iot/meta-common/meta-qt5 \
  ${TOPDIR}/../meta-ref-os-iot/meta-common/meta-ros \
  ${TOPDIR}/../meta-ref-os-iot/meta-common/meta-java \
  ${TOPDIR}/../meta-ref-os-iot/meta-common/meta-batman \
  ${TOPDIR}/../meta-ref-os-iot/meta-common/meta-intel-camera \
  ${TOPDIR}/../meta-ref-os-iot/meta-common/meta-intel-arduino \
"

BBLAYERS += "${REF-OS_LAYERS}"
BBLAYERS_NON_REMOVABLE += "${REF-OS_LAYERS}"
```

## meta-ref-os-iot/conf/distro/distro-include/ref-os-added-dependencies.inc
```bitbake
RDEPENDS_pn-gstreamer1.0-meta-audio_append = " \
    gstreamer1.0-plugins-good-audioparsers \
    gstreamer1.0-plugins-good-pulse \
    gstreamer1.0-plugins-base-audiotestsrc \
    "

HOSTTOOLS_append = " xz pkg-config cc bc svn seq"
```

## meta-ref-os-iot/conf/distro/distro-include/ref-os-packagearch.inc
```bitbake
# Correct debian package architecture for some packages
DPKG_ARCH_pn-kernel-devsrc="all"
```

## meta-ref-os-iot/conf/distro/distro-include/ref-os-removed-dependencies.inc
```bitbake
# Disable ed, quilt and intltool from tools-sdk
RDEPENDS_packagegroup-core-sdk_remove = "ed"
RDEPENDS_packagegroup-core-sdk_remove += "quilt"
RDEPENDS_packagegroup-core-sdk_remove += "intltool"
RDEPENDS_packagegroup-core-x11-base_remove += "matchbox-terminal matchbox-wm"

# OS removed dependencies
RDEPENDS_pn-xserver-common_remove = "fbset"
RDEPENDS_remove_gstreamer1.0-meta-audio = "gstreamer1.0-plugins-good-flac"

# fwts configures automatically not to include dtc, if it is missing
PNBLACKLIST[dtc] ?= "Not a needed nor intel-whitelisted test package"
DEPENDS_remove_pn-fwts = "dtc"

# Remove xinput caliberator from the image
RDEPENDS_packagegroup-core-x11-utils_remove += "xinput-calibrator"

# remove enchant from the image
DEPENDS_remove_pn-gedit = "enchant"

# Remove dependency with ocl-icd
PNBLACKLIST[ocl-icd] ?= "Removed"
PACKAGECONFIG_remove_pn-opencv = "opencl"
DEPENDS_remove_pn-beignet-570x = "ocl-icd"

# Remove libusb-compat and replace it with libusb1
PNBLACKLIST[libusb-compat] = "Not a whitelisted component"
PROVIDES_append_pn-libusb1 = " libusb"
DEPENDS_remove_pn-libgphoto2 = "virtual/libusb0"

# Remove dependency with libexif
EXTRA_OECONF_append_pn-libgphoto2 = " --with-libexif=no"
EXTRA_OECONF_append_pn-thunar = " --disable-exif"
DEPENDS_remove_pn-libgphoto2 = "libexif"

# Remove dependency with some gstreamer plugins, based on code review

# Remove libogg and dependent codecs (flac, vorbis and theora)
PNBLACKLIST[libtheora] ?= "Removed due to dependency to libogg"
DEPENDS_remove_pn-gst-plugins-base = "libogg"
DEPENDS_remove_pn-gstreamer1 = "libtheora"
DEPENDS_remove_pn-gstreamer1.0-plugins-base = "libtheora"
PACKAGECONFIG_remove_pn-gstreamer1.0-plugins-base = "ogg"
PACKAGECONFIG_remove_pn-gstreamer1.0-plugins-base = "vorbis"
DEPENDS_remove_pn-speex = "libogg"

# Remove dependencies to libogg from libsndfile1 
DEPENDS_remove_pn-libsndfile1 = "libogg"
DEPENDS_remove_pn-libsndfile1 = "libvorbis"
DEPENDS_remove_pn-libsndfile1 = "flac"
EXTRA_OECONF_append_pn-libsndfile1 = " --disable-external-libs"

# Remove dependency to cryptodev
DEPENDS_remove_pn-openssl = "cryptodev-linux"
CFLAG_remove_pn-openssl = "-DHAVE_CRYPTODEV"

# Remove dependency to mbedtls
SRC_URI_remove_pn-iotivity = "${url_mbedtls};name=mbedtls;destsuffix=${S}/extlibs/mbedtls/mbedtls;protocol=http"
# Remove dependency to sysfsutils
DEPENDS_remove_pn-bridge-utils = "sysfsutils"

# Remove xinput caliberator from the image
RDEPENDS_nativesdk-packagegroup-sdk-host_remove += "nativesdk-dnf"
```

## meta-ref-os-iot/conf/distro/distro-include/security_flags.inc
```bitbake
SECURITY_CFLAGS_pn-protobuf = "${SECURITY_NO_PIE_CFLAGS}"
SECURITY_CFLAGS_pn-tbb = "${SECURITY_NO_PIE_CFLAGS}"
SECURITY_CFLAGS_pn-log4cxx = "${SECURITY_NO_PIE_CFLAGS}"
SECURITY_CFLAGS_pn-python-imaging = "${SECURITY_NO_PIE_CFLAGS}"
SECURITY_CFLAGS_pn-python-pyyaml = "${SECURITY_NO_PIE_CFLAGS}"
SECURITY_CFLAGS_pn-python-netifaces = "${SECURITY_NO_PIE_CFLAGS}"
SECURITY_CFLAGS_pn-libsigc++-2.0 = "${SECURITY_NO_PIE_CFLAGS}"
SECURITY_CFLAGS_pn-libcairomm-1.0 = "${SECURITY_NO_PIE_CFLAGS}"
SECURITY_CFLAGS_pn-cairomm = "${SECURITY_NO_PIE_CFLAGS}"
SECURITY_CFLAGS_pn-glibmm = "${SECURITY_NO_PIE_CFLAGS}"
SECURITY_CFLAGS_pn-pangomm = "${SECURITY_NO_PIE_CFLAGS}"
SECURITY_CFLAGS_pn-atkmm = "${SECURITY_NO_PIE_CFLAGS}"
SECURITY_CFLAGS_pn-gtkmm = "${SECURITY_NO_PIE_CFLAGS}"
SECURITY_CFLAGS_pn-beignet = "${SECURITY_NO_PIE_CFLAGS}"
SECURITY_CFLAGS_pn-clang = "${SECURITY_NO_PIE_CFLAGS} ${SECURITY_PIC_CFLAGS}"
SECURITY_CFLAGS_pn-wxpython-phoenix = "${SECURITY_NO_PIE_CFLAGS}"
```

## meta-ref-os-iot/conf/distro/distro-include/x11-config.inc
```bitbake
PACKAGECONFIG_append_pn-mesa = " dri3"
PACKAGECONFIG_append_pn-xf86-video-intel = " dri3"
PACKAGECONFIG_append_pn-xserver-xorg = " dri3 xshmfence"
```
